// SPDX-License-Identifier: GPL-2.0-or-later OR MIT
/*
 * Copyright 2020-2022 Toradex
 */

// Verdin DSI to LVDS Adapter with connected LT170410 display (10 inch) with a
// resolution of 1280x800 pixel. Adapter and display can be ordered at Toradex.

&{/} {
	panel_kd101wxdi01: panel_kd101wxdi01{
		compatible = "panel-lvds";
		data-mapping = "vesa-24";
		height-mm = <136>;
		width-mm = <217>;

			panel-timing {
			//clock-frequency = <69300000 69300000 69300000>;
			clock-frequency = <72400000 72400000 72400000>;
			de-active = <1>;
			hactive = <1280 1280 1280>;
			//hactive = <1280 1280 1280>;
			hback-porch = <88 88 88>;
			//hback-porch = <100 100 100>;
			hfront-porch = <62 62 62>;
			//hfront-porch = <17 17 17>;
			hsync-len = <10 10 10>;
			pixelclk-active = <1>; /* positive edge */
			vactive = <800 800 800>;
			vback-porch = <22 22 22>;
			vfront-porch = <14 14 14>;
			vsync-len = <2 2 2>;
		};
	};
};

